## drivers/media/dvb/siano/Kconfig
```kconfig
#
# Siano Mobile Silicon Digital TV device configuration
#

config SMS_SIANO_MDTV
	tristate "Siano SMS1xxx based MDTV receiver 12345111"
	depends on DVB_CORE && RC_CORE && HAS_DMA
	---help---
	  Choose Y or M here if you have MDTV receiver with a Siano chipset.

	  To compile this driver as a module, choose M here
	  (The module will be called smsmdtv).

	  Further documentation on this driver can be found on the WWW
	  at http://www.siano-ms.com/

if SMS_SIANO_MDTV
menu "Siano module components"

# Hardware interfaces support

config SMS_USB_DRV
	tristate "USB interface support"
	depends on DVB_CORE && USB
	---help---
	  Choose if you would like to have Siano's support for USB interface

config SMS_SDIO_DRV
	tristate "SDIO interface support"
	depends on DVB_CORE && MMC
	---help---
	  Choose if you would like to have Siano's support for SDIO interface
endmenu
endif # SMS_SIANO_MDTV

config SMS_SIANO_DEBUGFS
        bool "Enable debugfs for smsdvb"
        depends on SMS_SIANO_MDTV
        depends on DEBUG_FS
	depends on SMS_USB_DRV
        depends on CONFIG_SMS_USB_DRV = CONFIG_SMS_SDIO_DRV
        default y

        ---help---
        Choose Y to enable visualizing a dump of the frontend
        statistics response packets via debugfs. Currently, works
        only with Siano USB devices.

        Useful only for developers. In doubt, say N.
```

## drivers/media/usb/Kconfig
```kconfig
if USB && MEDIA_SUPPORT

menuconfig MEDIA_USB_SUPPORT
	bool "Media USB Adapters"
	help
	  Enable media drivers for USB bus.
	  If you have such devices, say Y.

if MEDIA_USB_SUPPORT

if MEDIA_CAMERA_SUPPORT
	comment "usb cap."
source "drivers/media/usb/usbtv/Kconfig"
endif

endif #MEDIA_USB_SUPPORT
endif #USB
```

## drivers/media/video/sun7i_tvd.del/Kconfig
```kconfig
config SUN7I_TVD
	tristate "sun7i TV Decoder support"
	default m
	depends on VIDEO_DEV && VIDEO_V4L2
	select VIDEOBUF_DMA_CONTIG
	---help---
	  This is the driver of sun7i TV decoder.
```
